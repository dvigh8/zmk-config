/*
 * Copyright (c) 2024 The ZMK Contributors
 *
 * SPDX-License-Identifier: MIT
 */

#include "stryx.dtsi"

&matrix_transform0 {
    col-offset = <6>;
};

&kscan0 {
    col-gpios
        = <&pro_micro 4 GPIO_ACTIVE_HIGH> // D4 (P0.22) - col1
        , <&pro_micro 5 GPIO_ACTIVE_HIGH> // D5 (P0.24) - col2
        , <&pro_micro 6 GPIO_ACTIVE_HIGH> // D6 (P1.00) - col3
        , <&pro_micro 7 GPIO_ACTIVE_HIGH> // D7 (P0.11) - col4
        , <&pro_micro 20 GPIO_ACTIVE_HIGH> // D20 (P0.29) - col5
        , <&pro_micro 21 GPIO_ACTIVE_HIGH> // D21 (P0.31) - col6
        ;
};

// Nice!view display will be configured by the nice_view shield
// Just disable I2C since Nice!View uses SPI
&pro_micro_i2c {
    status = "disabled";
};
