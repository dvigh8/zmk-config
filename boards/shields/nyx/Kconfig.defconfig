## boards/shields/nyx/Kconfig.defconfig
```kconfig
if SHIELD_NYX_LEFT

config ZMK_KEYBOARD_NAME
    default "nyx"

config ZMK_SPLIT_ROLE_CENTRAL
    default y

endif # SHIELD_NYX_LEFT

if SHIELD_NYX_LEFT || SHIELD_NYX_RIGHT

config ZMK_SPLIT
    default y

endif # SHIELD_NYX_LEFT || SHIELD_NYX_RIGHT
```

## boards/shields/stryx/Kconfig.defconfig
```kconfig
# Copyright (c) 2024 The ZMK Contributors
# SPDX-License-Identifier: MIT

if SHIELD_STRYX_LEFT

config ZMK_KEYBOARD_NAME
    default "Stryx"

config ZMK_SPLIT_ROLE_CENTRAL
    default y

endif

if SHIELD_STRYX_LEFT || SHIELD_STRYX_RIGHT

config ZMK_SPLIT
    default y

endif
```

## boards/shields/stryx/Kconfig.shield
```kconfig
# Copyright (c) 2024 The ZMK Contributors
# SPDX-License-Identifier: MIT

config SHIELD_STRYX_LEFT
    def_bool $(shields_list_contains,stryx_left)

config SHIELD_STRYX_RIGHT
    def_bool $(shields_list_contains,stryx_right)
```

## boards/shields/tyrian/Kconfig.defconfig
```kconfig
if SHIELD_TYRIAN_LEFT

config ZMK_KEYBOARD_NAME
    default "Tyrian"

config ZMK_SPLIT_ROLE_CENTRAL
    default y

endif # SHIELD_TYRIAN_LEFT

if SHIELD_TYRIAN_LEFT || SHIELD_TYRIAN_RIGHT

config ZMK_SPLIT
    default y

endif # SHIELD_TYRIAN_LEFT || SHIELD_TYRIAN_RIGHT
```

## boards/shields/tyrian/Kconfig.shield
```kconfig
config SHIELD_TYRIAN_LEFT
    def_bool $(shields_list_contains,tyrian_left)

config SHIELD_TYRIAN_RIGHT
    def_bool $(shields_list_contains,tyrian_right)
```
