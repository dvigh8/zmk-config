// This file was generated from a template. Edit it to match your keyboard.
// See https://zmk.dev/docs/development/hardware-integration/new-shield for more
// instructions.

#include "tyrian.dtsi"

&default_transform {
    // Set this to the number of columns on the left side.
    col-offset = <8>;
};

&kscan {
    // Replace these comments with the GPIO pins in the matrix for the right side.
    // See https://zmk.dev/docs/development/hardware-integration/new-shield#shield-overlays
    col-gpios
        = <&pro_micro 10 GPIO_ACTIVE_HIGH> // D21 - col1
        , <&pro_micro 16 GPIO_ACTIVE_HIGH> // D16 - col7
        , <&pro_micro 14 GPIO_ACTIVE_HIGH> // D14 - col6
        , <&pro_micro 15 GPIO_ACTIVE_HIGH> // D15 - col5
        , <&pro_micro 18 GPIO_ACTIVE_HIGH> // D18 - col4
        , <&pro_micro 19 GPIO_ACTIVE_HIGH> // D19 - col3
        , <&pro_micro 20 GPIO_ACTIVE_HIGH> // D20 - col2
        , <&pro_micro 21 GPIO_ACTIVE_HIGH> // D10 - col8
        ;
};
